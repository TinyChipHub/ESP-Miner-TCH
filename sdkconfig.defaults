## sdkconfig.defaults
```kconfig
CONFIG_PARTITION_TABLE_CUSTOM=y
CONFIG_PARTITION_TABLE_CUSTOM_FILENAME="partitions.csv"
CONFIG_PARTITION_TABLE_FILENAME="partitions.csv"
CONFIG_PARTITION_TABLE_OFFSET=0x8000
CONFIG_PARTITION_TABLE_MD5=y
CONFIG_ESPTOOLPY_FLASHSIZE_16MB=y
CONFIG_ESPTOOLPY_FLASHSIZE="16MB"
CONFIG_HTTPD_WS_SUPPORT=y
CONFIG_SPIFFS_OBJ_NAME_LEN=64
CONFIG_HTTPD_MAX_URI_LEN=2048
CONFIG_ESP32S3_DEFAULT_CPU_FREQ_240=y
CONFIG_ESP_WIFI_11KV_SUPPORT=y
CONFIG_LV_CONF_SKIP=n
CONFIG_BT_ENABLED=n
CONFIG_LWIP_MAX_SOCKETS=16
CONFIG_SPIRAM=y
CONFIG_SPIRAM_MODE_OCT=y
CONFIG_SPIRAM_SPEED_80M=y
CONFIG_SPIRAM_IGNORE_NOTFOUND=y
CONFIG_LOG_COLORS=y

# psram config
#CONFIG_ESP32S3_SPIRAM_SUPPORT=y
#CONFIG_SPIRAM_ALLOW_STACK_EXTERNAL_MEMORY=n
#CONFIG_SPIRAM_BOOT_INIT=y
#CONFIG_SPIRAM_MEMTEST=y
#CONFIG_SPIRAM_MODE_OCT=y
#CONFIG_SPIRAM_SPEED=40
#CONFIG_SPIRAM_SPEED_40M=y
#CONFIG_SPIRAM_TYPE_AUTO=y
#CONFIG_SPIRAM_USE_CAPS_ALLOC=y
#CONFIG_SPIRAM=y
```
